## conf/distro/rpb-wayland.conf
```bitbake
require conf/distro/include/rpb.inc

DISTRO_NAME = "Reference-Platform-Build-Wayland"

DISTRO_FEATURES_append = " wayland"
DISTRO_FEATURES_remove = "x11"

PREFERRED_PROVIDER_libgbm_omap-a15 = "libgbm"
PREFERRED_PROVIDER_libgbm-dev_omap-a15 = "libgbm-dev"

# FIXME looks like this isn't the best place for TI u-boot preferrencies..
PREFERRED_PROVIDER_virtual/bootloader_omap-a15 = "u-boot-ti-staging"
PREFERRED_PROVIDER_u-boot_omap-a15 = "u-boot-ti-staging"
```
